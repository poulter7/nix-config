#define VERSION_MACRO
macro_ver: macro_ver {
compatible = "zmk,behavior-macro";
#binding-cells = <0>;
bindings = <&kp N2>, <&kp N0>, <&kp N2>, <&kp N5>, <&kp N0>, <&kp N3>, <&kp N1>, <&kp N0>, <&kp MINUS>, <&kp H>, <&kp E>, <&kp A>, <&kp D>, <&kp MINUS>, <&kp E>, <&kp B>, <&kp C>, <&kp F>, <&kp N4>, <&kp N7>, <&kp C>, <&kp MINUS>, <&kp C>, <&kp L>, <&kp I>, <&kp Q>, <&kp U>, <&kp E>, <&kp RET>;
};
